/ {
    behaviors {
        behavior_mouse_layer_on: behavior_mouse_layer_on {
            compatible = "zmk,behavior-mod-momentary";
            label = "MOUSE_LAYER_ON";
            #binding-cells = <0>;
            bindings = <&mo 4>;  // レイヤー番号4がマウスレイヤー
        };
    };
};
