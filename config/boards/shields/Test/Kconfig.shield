## config/boards/shields/Test/Kconfig.shield
```kconfig
config SHIELD_ROBA_DONGLE_CENTER
    def_bool $(shields_list_contains,roBa_dongle_center)

config SHIELD_ROBA_R
    def_bool $(shields_list_contains,roBa_R)

config SHIELD_ROBA_L
    def_bool $(shields_list_contains,roBa_L)
```
